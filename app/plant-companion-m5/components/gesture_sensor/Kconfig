## app/plant-companion/ai_module/Kconfig
```kconfig
############################################################################
# apps/plant-companion/ai_module/Kconfig
#
# AI 模块配置选项
############################################################################

config PLANT_AI_MODULE
	bool "Enable Plant Companion AI Module"
	default n
	depends on ESP32S3_WIFI
	---help---
		Enable the AI module for plant care analysis.
		This requires WiFi connectivity to access MiMo API.

if PLANT_AI_MODULE

config PLANT_AI_API_KEY
	string "MiMo API Key"
	default ""
	---help---
		The API key for Xiaomi MiMo platform.
		Get it from https://api.xiaomimimo.com

config PLANT_AI_TEXT_CHAT
	bool "Enable Text Chat Module"
	default y
	---help---
		Enable the text chat module for plant care Q&A.

config PLANT_AI_IMAGE_DETECT
	bool "Enable Image Detection Module"
	default y
	depends on BOARD_CAMERA_OV3660
	---help---
		Enable the image detection module for plant disease
		detection. Requires camera support.

config PLANT_AI_ANALYSIS
	bool "Enable AI Analysis Module"
	default y
	depends on PLANT_AI_TEXT_CHAT
	---help---
		Enable the comprehensive AI analysis module that
		combines sensor data and image analysis.

config PLANT_AI_DEBUG
	bool "Enable AI Module Debug"
	default n
	---help---
		Enable debug output for AI module.

endif # PLANT_AI_MODULE
```

## app/plant-companion/components/sensor_driver/Kconfig
```kconfig
#
# apps/plant-companion/components/sensor_driver/Kconfig
#
# Soil Sensor configuration
#

config PLANT_SOIL_SENSOR
	bool "Soil Sensor (RS485 Modbus)"
	default n
	---help---
		Enable RS485 soil sensor with 8 parameters.
		Requires UART0 on IO43/IO44.

if PLANT_SOIL_SENSOR

config PLANT_SOIL_SENSOR_DEV
	string "UART device"
	default "/dev/ttyS0"
	---help---
		UART device for RS485 communication.

config PLANT_SOIL_SENSOR_BAUD
	int "Baudrate"
	default 9600
	---help---
		Baudrate for RS485 communication.

endif # PLANT_SOIL_SENSOR
```

## app/soil-node/Kconfig
```kconfig
config SOIL_NODE
	bool "ZhiXiaoBan soil node"
	default n
	depends on ESP32_WIFI && NETUTILS_MQTTC
	---help---
		OpenVela soil sensor node for ESP32-WROOM-32E.
		Reads an RS485 Modbus soil sensor, stores configuration,
		connects Wi-Fi, exposes a provisioning page, and publishes
		JSON readings over MQTT.

if SOIL_NODE

config SOIL_NODE_PROGNAME
	string "Program name"
	default "soil_node"

config SOIL_NODE_PRIORITY
	int "Task priority"
	default 100

config SOIL_NODE_AUTOSTART
	bool "Start the soil node at boot"
	default y

config SOIL_NODE_STACKSIZE
	int "Task stack size"
	default 24576

config SOIL_NODE_DEEP_SLEEP
	bool "Deep sleep between upload cycles"
	default y

config SOIL_NODE_MQTT_TLS
	bool "MQTT over TLS using the ESP32 HAL mbedTLS"
	default y
	help
	  Build MQTT-C against the mbedTLS copy embedded in the ESP32
	  HAL. This avoids linking a second mbedTLS instance from apps.

config SOIL_NODE_UART_DEV
	string "RS485 UART device"
	default "/dev/ttyS1"

endif
```
